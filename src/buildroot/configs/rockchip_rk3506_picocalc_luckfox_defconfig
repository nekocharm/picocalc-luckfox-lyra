## src/buildroot/configs/rockchip_rk3506_picocalc_luckfox_defconfig
```kconfig
BR2_arm=y
BR2_cortex_a7=y
BR2_TOOLCHAIN_BUILDROOT_CXX=y
BR2_PRIMARY_SITE="https://sources.buildroot.net"
BR2_BACKUP_SITE=""
BR2_GNU_MIRROR="https://mirrors.ustc.edu.cn/gnu"
BR2_FORCE_HOST_BUILD=y
BR2_TIME_BITS_64=y
BR2_TARGET_GENERIC_HOSTNAME="luckfox"
BR2_TARGET_GENERIC_ISSUE="Welcome to Luckfox Lyra [root:luckfox]"
BR2_ROOTFS_DEVICE_CREATION_DYNAMIC_EUDEV=y
BR2_ROOTFS_MERGED_USR=y
BR2_TARGET_GENERIC_ROOT_PASSWD="luckfox"
BR2_TARGET_SERIAL_SHELL_GETTY=y
# BR2_TARGET_GENERIC_REMOUNT_ROOTFS_RW is not set
BR2_GENERATE_LOCALE="en_US.UTF-8"
BR2_ROOTFS_OVERLAY="board/rockchip/rk3506/picocalc-overlay/"
BR2_ROOTFS_POST_BUILD_SCRIPT="board/rockchip/common/post-build.sh board/rockchip/rk3506/post-build-fast-display.sh"
BR2_LINUX_KERNEL_CUSTOM_LOCAL=y
BR2_LINUX_KERNEL_CUSTOM_LOCAL_LOCATION="$(TOPDIR)/../kernel"
BR2_PACKAGE_ROCKCHIP=y
BR2_PACKAGE_RK3506=y
BR2_PACKAGE_RKADK=y
BR2_PACKAGE_RKADK_DISPLAY=y
BR2_PACKAGE_RKADK_PLAYER=y
BR2_PACKAGE_RKADK_EXAMPLES=y
BR2_PACKAGE_RKSCRIPT=y
BR2_PACKAGE_RKTOOLKIT=y
BR2_PACKAGE_RKWIFIBT_APP=y
BR2_PACKAGE_ROCKCHIP_ALSA_CONFIG=y
BR2_ROCKCHIP_ALSA_CONFIG_INSTALL_INIT_SCRIPT=y
BR2_PACKAGE_ROCKCHIP_RGA=y
# BR2_PREFER_ROCKCHIP_RGA is not set
BR2_PACKAGE_ROCKCHIP_TEST=y
BR2_PACKAGE_BUSYBOX_CONFIG_FRAGMENT_FILES="board/rockchip/common/base/busybox.fragment"
BR2_PACKAGE_BUSYBOX_SHOW_OTHERS=y
BR2_PACKAGE_ALSA_UTILS=y
BR2_PACKAGE_ALSA_UTILS_ALSACONF=y
BR2_PACKAGE_ALSA_UTILS_AMIXER=y
BR2_PACKAGE_ALSA_UTILS_APLAY=y
BR2_PACKAGE_RIPGREP=y
BR2_PACKAGE_DOSFSTOOLS=y
BR2_PACKAGE_DOSFSTOOLS_FATLABEL=y
BR2_PACKAGE_DOSFSTOOLS_FSCK_FAT=y
BR2_PACKAGE_DOSFSTOOLS_MKFS_FAT=y
BR2_PACKAGE_E2FSPROGS=y
BR2_PACKAGE_E2FSPROGS_RESIZE2FS=y
BR2_PACKAGE_FATRESIZE=y
BR2_PACKAGE_MTD=y
BR2_PACKAGE_SL=y
BR2_PACKAGE_FBV=y
BR2_PACKAGE_EVTEST=y
BR2_PACKAGE_INPUT_EVENT_DAEMON=y
BR2_PACKAGE_MHZ=y
BR2_PACKAGE_PM_UTILS=y
BR2_PACKAGE_USBMOUNT=y
BR2_PACKAGE_PYTHON3=y
BR2_PACKAGE_PYTHON3_SSL=y
BR2_PACKAGE_PYTHON_AIOHTTP=y
BR2_PACKAGE_PYTHON_CANOPEN=y
BR2_PACKAGE_PYTHON_CLICK=y
BR2_PACKAGE_PYTHON_ITSDANGEROUS=y
BR2_PACKAGE_PYTHON_JINJA2=y
BR2_PACKAGE_PYTHON_PERIPHERY=y
BR2_PACKAGE_PYTHON_PILLOW=y
BR2_PACKAGE_PYTHON_SERIAL=y
BR2_PACKAGE_PYTHON_SETUPTOOLS=y
BR2_PACKAGE_PYTHON_SMBUS_CFFI=y
BR2_PACKAGE_PYTHON_SPIDEV=y
BR2_PACKAGE_PYTHON_WERKZEUG=y
BR2_PACKAGE_ALSA_UCM_CONF=y
BR2_PACKAGE_LIBMAD=y
BR2_PACKAGE_LIBOPENSSL_BIN=y
BR2_PACKAGE_FREETYPE=y
BR2_PACKAGE_LIBJPEG=y
BR2_PACKAGE_LIBCURL=y
BR2_PACKAGE_LIBCAP=y
BR2_PACKAGE_LIBEVDEV=y
BR2_PACKAGE_CAN_UTILS=y
BR2_PACKAGE_DNSMASQ=y
BR2_PACKAGE_HOSTAPD=y
BR2_PACKAGE_IPERF3=y
BR2_PACKAGE_IPROUTE2=y
BR2_PACKAGE_OPENSSH=y
BR2_PACKAGE_OPENSSH_GEN_KEYS=y
BR2_PACKAGE_PHYTOOL=y
BR2_PACKAGE_OPKG=y
BR2_PACKAGE_TMUX=y
BR2_PACKAGE_ANDROID_ADBD=y
BR2_PACKAGE_UTIL_LINUX_AGETTY=y
BR2_PACKAGE_UTIL_LINUX_MOUNT=y
BR2_PACKAGE_NANO=y
BR2_PACKAGE_VIM=y
BR2_TARGET_ROOTFS_CPIO=y
BR2_TARGET_ROOTFS_CPIO_GZIP=y
BR2_TARGET_ROOTFS_EXT2=y
BR2_TARGET_ROOTFS_EXT2_4=y
BR2_TARGET_ROOTFS_EXT2_SIZE_AUTO=y
BR2_TARGET_ROOTFS_SQUASHFS=y
BR2_TARGET_ROOTFS_SQUASHFS4_ZSTD=y
BR2_TARGET_ROOTFS_UBI=y
BR2_TARGET_ROOTFS_UBI_SUBSIZE=2048
BR2_TARGET_ROOTFS_UBI_OPTS="-v"
BR2_TARGET_ROOTFS_UBIFS_LEBSIZE=0x1f000
BR2_TARGET_ROOTFS_UBIFS_MAX_SIZE=1024
BR2_TARGET_ROOTFS_UBIFS_OPTS="-F -v"
BR2_PACKAGE_HOST_ENVIRONMENT_SETUP=y
BR2_PACKAGE_HOST_NTFS_3G=y
BR2_PACKAGE_HOST_PYTHON3=y
BR2_PACKAGE_HOST_PYTHON3_SSL=y
```

## src/buildroot/package/retroarch/libretro-dosboxpure/Config.in
```kconfig
config BR2_PACKAGE_LIBRETRO_DOSBOXPURE
        bool "libretro-dosbox-pure"
	depends on BR2_PACKAGE_RETROARCH
	depends on BR2_INSTALL_LIBSTDCPP
        help
          libretro dosbox pure core.

	  http://www.libretro.com

comment "LIBRETRO_DOSBOX needs a toolchain w/ C++"
	depends on !BR2_INSTALL_LIBSTDCPP
```

## src/device/rockchip/.chips/rk3506/amp_mcu.its
```
/*
 * Copyright (C) 2023 Rockchip Electronics Co., Ltd
 *
 * SPDX-License-Identifier: GPL-2.0
 */

/dts-v1/;
/ {
	description = "Rockchip AMP FIT Image";
	#address-cells = <1>;

	images {
		mcu {
			description  = "mcu";
			data         = /incbin/("./mcu.bin");
			type         = "standalone";	// must be "standalone"
			compression  = "none";
			arch         = "arm";		// "arm64" or "arm", the same as U-Boot state
			load         = <0xfff84000>;
			udelay       = <100000>;
			compile {
				size     = <0x00008000>;
				sys      = "hal";
				core     = "mcu";
			};
			hash {
				algo = "sha256";
			};
		};
	};

	share {
        shm_base         = <0x03c00000>;
        shm_size         = <0x00008000>;
    };

	configurations {
		default = "conf";
		conf {
			description = "Rockchip AMP images";
			rollback-index = <0x0>;
			loadables = "mcu";

			signature {
				algo = "sha256,rsa2048";
				padding = "pss";
				key-name-hint = "dev";
				sign-images = "loadables";
			};
		};
	};
};
```

## src/kernel-6.1/sound/pwm/Kconfig
```kconfig
# SPDX-License-Identifier: GPL-2.0-only
#PWM drivers

menuconfig SND_PWM
	bool "PWM sound devices"
	help
	  Support for sound devices connected via the PWM.

if SND_PWM

config SOFTPWM_SOUND
	bool "RK3506 MCU Soft PWM Sound driver"
	select SND_PCM
	help
	  Support for sound devices connected via the MCU Soft PWM.

endif	# SND_PWM
```
